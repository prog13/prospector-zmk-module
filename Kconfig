## Kconfig
```kconfig
choice PROSPECTOR_STATUS_SCREEN_LAYOUT
    prompt "Status screen layout"
    default PROSPECTOR_STATUS_SCREEN_CLASSIC

config PROSPECTOR_STATUS_SCREEN_CLASSIC
    bool "Classic layout"
    help
        Standard Prospector status screen

config PROSPECTOR_STATUS_SCREEN_RADII
    bool "Radii layout"
    help
        Colorful grid layout with rounded widgets

config PROSPECTOR_STATUS_SCREEN_FIELD
    bool "Field layout"
    help
        Minimal layout with flowing typing activity visualization

config PROSPECTOR_STATUS_SCREEN_FLUX
    bool "Flux layout"
    help
        Minimal layout drawing the field lines of a slowly wandering set of poles

config PROSPECTOR_STATUS_SCREEN_FERRO
    bool "Ferro layout"
    help
        The flux poles rendered as ferrofluid: filled blobs that drift, merge and split

config PROSPECTOR_STATUS_SCREEN_OPERATOR
    bool "Operator layout"
    help
        Technical and information dense layout

endchoice

config PROSPECTOR_ROTATE_DISPLAY_180
    bool "Rotate the display 180 degrees"
    default n

config PROSPECTOR_SHOW_MODIFIERS
    bool "Display modifier key indicators (Cmd, Opt, Ctrl, Shift)"
    default y

config PROSPECTOR_SHOW_INACTIVE_MODIFIERS
    bool "Show inactive modifier indicators (dim when not pressed)"
    default y
    depends on PROSPECTOR_SHOW_MODIFIERS
    help
      When enabled, inactive modifiers are shown with a dim color.
      When disabled, inactive modifiers are hidden completely.
      Only affects classic and field layouts.

config PROSPECTOR_MODIFIER_ORDER
    string "Modifier display order"
    default "GACS"
    depends on PROSPECTOR_SHOW_MODIFIERS
    help
      Order of modifier indicators. Use exactly 4 characters:
      G=GUI/Cmd, A=Alt/Opt, C=Control, S=Shift.
      Each character must appear exactly once.

choice PROSPECTOR_MODIFIER_OS
    prompt "Modifier key style"
    default PROSPECTOR_MODIFIER_OS_MAC
    depends on PROSPECTOR_SHOW_MODIFIERS

config PROSPECTOR_MODIFIER_OS_GENERIC
    bool "Generic (CTRL, ALT, GUI, SHFT)"

config PROSPECTOR_MODIFIER_OS_WINDOWS
    bool "Windows"

config PROSPECTOR_MODIFIER_OS_MAC
    bool "Mac"

endchoice

config PROSPECTOR_USE_AMBIENT_LIGHT_SENSOR
    bool "Use ambient light sensor for auto brightness"
    default y

config PROSPECTOR_FIXED_BRIGHTNESS
    int "Fixed display brightness"
    default 50
    range 1 100
    depends on !PROSPECTOR_USE_AMBIENT_LIGHT_SENSOR

config PROSPECTOR_USE_TOUCH
    bool "Read the touch events"
    default n
    depends on DT_HAS_HYNITRON_CST816S_ENABLED

config PROSPECTOR_TOUCH_DEBUG
    bool "Show a touch debug readout"
    default n
    depends on PROSPECTOR_USE_TOUCH

choice PROSPECTOR_TOUCH_BRIGHTNESS_CONTROL
    prompt "Touch control for display brightness"
    default PROSPECTOR_TOUCH_BRIGHTNESS
    depends on PROSPECTOR_USE_TOUCH && !PROSPECTOR_USE_AMBIENT_LIGHT_SENSOR

config PROSPECTOR_TOUCH_BRIGHTNESS_NONE
    bool "Leave the brightness alone"

config PROSPECTOR_TOUCH_BRIGHTNESS
    bool "Drag up and down the screen"

endchoice

config PROSPECTOR_TOUCH_BRIGHTNESS_TRAVEL
    int "Drag distance for the full brightness range, in panel counts"
    default 420
    range 1 1000
    depends on PROSPECTOR_TOUCH_BRIGHTNESS

config PROSPECTOR_TOUCH_FIELD_POLE
    bool "Make a fingertip a pole in the field"
    default y
    depends on PROSPECTOR_USE_TOUCH && (PROSPECTOR_STATUS_SCREEN_FLUX || PROSPECTOR_STATUS_SCREEN_FERRO)
    help
      The contact becomes another pole in the field the layout draws, so
      the field reorganises around the finger and relaxes once it lifts. Leaves the
      brightness drag alone.

choice PROSPECTOR_FERRO_PALETTE
    prompt "Ferro palette"
    default PROSPECTOR_FERRO_PALETTE_MONO
    depends on PROSPECTOR_STATUS_SCREEN_FERRO
    help
      Two-colour monitor pairs from Obra Dinn's 1-bit set.

config PROSPECTOR_FERRO_PALETTE_MACINTOSH
    bool "Macintosh"

config PROSPECTOR_FERRO_PALETTE_IBM8503
    bool "IBM 8503 (warm grey)"

config PROSPECTOR_FERRO_PALETTE_IBM5151
    bool "IBM 5151 (green)"

config PROSPECTOR_FERRO_PALETTE_ZENITH
    bool "Zenith ZVM 1240 (amber)"

config PROSPECTOR_FERRO_PALETTE_COMMODORE
    bool "Commodore 1084 (blue)"

config PROSPECTOR_FERRO_PALETTE_MONO
    bool "Monochrome (grey on black)"

endchoice

# Index into ferro_palettes[]; the order is the generator's, not this file's.
config PROSPECTOR_FERRO_PALETTE_INDEX
    int
    depends on PROSPECTOR_STATUS_SCREEN_FERRO
    default 0 if PROSPECTOR_FERRO_PALETTE_MACINTOSH
    default 1 if PROSPECTOR_FERRO_PALETTE_IBM8503
    default 2 if PROSPECTOR_FERRO_PALETTE_IBM5151
    default 3 if PROSPECTOR_FERRO_PALETTE_ZENITH
    default 4 if PROSPECTOR_FERRO_PALETTE_COMMODORE
    default 5

config PROSPECTOR_LAYER_NAME_UPPERCASE
    bool "Display layer names in uppercase"
    default y
    help
      When enabled, layer names will be converted to uppercase for display.
```

## boards/shields/prospector_adapter/Kconfig.defconfig
```kconfig
if SHIELD_PROSPECTOR_ADAPTER

config ZMK_SPLIT_BLE_CENTRAL_BATTERY_LEVEL_FETCHING
    default y

config ZMK_DISPLAY
   default y

choice ZMK_DISPLAY_STATUS_SCREEN
    default ZMK_DISPLAY_STATUS_SCREEN_CUSTOM
endchoice

rsource "src/layouts/*/Kconfig.defconfig"

choice ZMK_DISPLAY_WORK_QUEUE
    default ZMK_DISPLAY_WORK_QUEUE_DEDICATED
endchoice

choice ST7789V_PIXEL_FORMAT
	default ST7789V_RGB565
endchoice

config LV_Z_VDB_SIZE
    default 50

config LV_Z_DOUBLE_VDB
    default y

config LV_Z_FLUSH_THREAD
    default y

config LV_Z_MEM_POOL_SIZE
    default 16384

# Run the input thread at a higher priority than the display thread. At the default it gets
# starved by rendering and drops touch events.
config INPUT_THREAD_PRIORITY_OVERRIDE
    default y if PROSPECTOR_USE_TOUCH

config INPUT_THREAD_PRIORITY
    default 4 if PROSPECTOR_USE_TOUCH

config LV_DPI_DEF
    default 261

config LV_Z_BITS_PER_PIXEL
	default 16

choice LV_COLOR_DEPTH
	default LV_COLOR_DEPTH_16
endchoice

config LV_COLOR_16_SWAP
	default y

choice LV_FONT_DEFAULT
    default LV_FONT_DEFAULT_MONTSERRAT_20
endchoice

config PWM
    default y

config LED
    default y

config PROSPECTOR_USE_AMBIENT_LIGHT_SENSOR
    select SENSOR
    select APDS9960

config PROSPECTOR_USE_TOUCH
    select INPUT

config LV_FONT_MONTSERRAT_14
    default y if PROSPECTOR_TOUCH_DEBUG

endif
```

## boards/shields/prospector_adapter/src/layouts/ferro/Kconfig.defconfig
```kconfig
if PROSPECTOR_STATUS_SCREEN_FERRO

config ZMK_DISPLAY_STATUS_SCREEN_CUSTOM
    select LV_USE_LABEL
    select LV_COLOR_SCREEN_TRANSP
    select ZMK_WPM

config PROSPECTOR_ANIMATION_INTENSITY_DECAY_SEC
    int "Time in seconds for the field to settle after typing stops"
    default 10
    range 5 120
    help
      The single window every typing response shares: how fast the fluid moves ramps up
      and decays over this. Longer values = the lamp stays lively for longer after you
      stop.

endif
```

## boards/shields/prospector_adapter/src/layouts/flux/Kconfig.defconfig
```kconfig
if PROSPECTOR_STATUS_SCREEN_FLUX

config ZMK_DISPLAY_STATUS_SCREEN_CUSTOM
    select LV_USE_LABEL
    select LV_COLOR_SCREEN_TRANSP
    select ZMK_WPM

config PROSPECTOR_ANIMATION_INTENSITY_DECAY_SEC
    int "Time in seconds for the field to settle after typing stops"
    default 10
    range 5 120
    help
      Opacity, line length and how fast the field moves all fade together over this window
      once you stop typing.

endif
```
